//LEVEL.H
#pragma once
#include "Engine.h"
#include "GameObject.h"
#include "Camera.h"
#include "Map.h"

#define ANY 255
#define REDS_HOUSE_F1  200
#define REDS_HOUSE_F2  201
#define LEVEL1  1
#define LEVEL2  2
#define LEVEL3  3

class Map;

// Define the maximum number of walkable tiles
static const uint8_t maxWalkableTiles = 40;

// Define the walkable tile indices
static const uint8_t walkableTiles[maxWalkableTiles] = {
    123,2,3,4,37, 65, 38, 1, 0, 5, 29, 30, 31, 32, 33, 14, 15, 16, 17, 18, 19, 42, 43, 84, 85, 86, 98, 99, 100, 112, 113, 114
};

// Function to check if a tile index is walkable
inline static bool isTileWalkable(uint8_t tileIndex) {
    for (uint8_t i = 0; i < maxWalkableTiles; ++i) {
        if (walkableTiles[i] == tileIndex) {
            return true;
        }
    }
    return false;
}

struct Warp {
    uint8_t x;
    uint8_t y;
    uint8_t warpTo;
    uint8_t px;
    uint8_t py;
    uint8_t dir;
};

struct Levels {
    uint8_t id;
    uint8_t mapSizeX;
    uint8_t mapSizeY;
    Warp warps[4];
    uint8_t numWarps;
};

static Levels levels[] = {
    {0, 20, 18, {}, 0}, // LEVEL 0
    {LEVEL1, 20, 18, {{5, 5, REDS_HOUSE_F1, 2, 7,UP},{13, 5, REDS_HOUSE_F1, 2, 7,UP},{10, -1, LEVEL2, 10, 35,UP},{11, -1, LEVEL2, 11, 35,UP}}, 4}, // LEVEL 1
    {LEVEL2, 20, 36, {{10, 35, LEVEL1, 10, 0,DOWN},{11, 35, LEVEL1, 11, 0,DOWN},{9, 0, LEVEL3, 16, 16,UP}}, 3}, // LEVEL 2
    {LEVEL3, 20, 36, {{10, 35, LEVEL1, 10, 0,DOWN},{11, 35, LEVEL1, 11, 0,DOWN},{9, 0, LEVEL3, 16, 16,UP}}, 3}, // LEVEL 3
    {REDS_HOUSE_F1, 8, 8, {{2, 7, LEVEL1, 5, 6,DOWN},{6, 2, REDS_HOUSE_F2, 1,3,ANY}}, 3}, // LEVEL REDS_HOUSE_F1
    {REDS_HOUSE_F2, 8, 8, {{1, 2, REDS_HOUSE_F1, 6, 3, ANY}}, 1}, // LEVEL REDS_HOUSE_F2
    // Define more levels as needed
};

inline static bool transition(GameObject* p) {
  uint8_t pTileX = (p->entity.center.x)  / tileSize;
  uint8_t pTileY = (p->entity.center.y) / tileSize;
  arduboy.println(pTileX);
  arduboy.println(pTileY);

  for (uint8_t l = 0; l < numLevels; l++) {
    if (curLevel == levels[l].id) {
      for (uint8_t w = 0; w < levels[l].numWarps; w++) {
        if (pTileX == levels[l].warps[w].x && pTileY == levels[l].warps[w].y) {
          if( p->entity.dir == levels[l].warps[w].dir || levels[l].warps[w].dir == ANY )
          {
            curLevel = levels[l].warps[w].warpTo;
            p->entity.x = levels[l].warps[w].px * tileSize;
            p->entity.y = levels[l].warps[w].py * tileSize;

            // Find the index of the current level based on its id
            for (uint8_t i = 0; i < numLevels; i++) {
              if (curLevel == levels[i].id) {
                // Update mapSizeX and mapSizeY based on the found index
                mapSizeX = levels[i].mapSizeX;
                mapSizeY = levels[i].mapSizeY;
                return true;
              }
            }
          }
        }
      }
    }
  }
  return false;
}

inline static void changeLevel( GameObject* p)
{
  if(transition(p))
    for(uint8_t l = 1; l < numLevels; l ++)
    {
      if(curLevel == l)
      {
        Engine::changeMapSize(levels[l].mapSizeX, levels[l].mapSizeY);
      }
    }
  fullMapHeight = mapSizeY * tileSize;
  fullMapWidth = mapSizeX * tileSize;
}

static const uint8_t level1[18][20] PROGMEM =
{
{30,33,32,36,31,33,31,33,30,36,37,37,36,29,33,29,33,30,36,31},
{36,36,36,36,36,36,36,36,36,36,37,37,36,36,36,36,36,36,36,36},
{36,30,84,85,85,85,85,85,85,85,1,1,85,85,85,85,85,86,33,36},
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{36,36,36,36,101,71,103,36,36,36,36,36,36,36,36,36,36,36,36,36},
};

static const uint8_t level3[18][20] PROGMEM =
{
{30,33,32,36,31,33,31,33,30,36,37,37,36,29,33,29,33,30,36,31},
{36,36,36,36,36,36,36,36,36,36,37,37,36,36,36,36,36,36,36,36},
{36,30,84,85,85,85,85,85,85,85,0,0,85,85,85,85,85,86,33,36},
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{36,36,36,36,101,71,103,36,36,36,36,36,36,36,36,36,36,36,36,36},
};

static const uint8_t level2[36][20] PROGMEM =
{
{1,1,1,36,1,1,1,1,36,38,38,36,1,1,1,1,1,1,36,1},
{1,1,1,36,36,36,36,36,36,38,38,36,36,36,36,36,36,36,36,1},
{1,1,1,36,1,1,1,1,1,38,38,1,1,1,1,1,19,19,36,1},
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{1,1,1,8,1,1,1,1,1,36,37,37,36,1,1,1,1,1,8,1},

};

static const uint8_t level1_Red_House_F1[8][8] PROGMEM =
{
	{124,124,124,124,124,124,124,124},
	{1,1,1,1,98,1,1,1},
	{1,1,1,1,98,1,65,1},
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	{1,2,3,4,1,1,1,1},
};
static const uint8_t level1_Red_House_F2[8][8] PROGMEM =
{
{124,124,124,124,124,124,124,124},
{1,1,1,45,46,1,1,1},
{1,65,1,1,1,1,1,1},
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{24,22,1,1,1,1,1,1},
};
